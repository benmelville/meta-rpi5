## conf/layer.conf
```bitbake
BBPATH .= ":${LAYERDIR}"

BBFILES += "${LAYERDIR}/recipes*/*/*.bb \
            ${LAYERDIR}/recipes*/*/*.bbappend"

LICENSE = "MIT"

BBFILE_COLLECTIONS += "rpi5"
BBFILE_PATTERN_rpi5 := "^${LAYERDIR}/"
BBFILE_PRIORITY_rpi5 = "20"

LAYERSERIES_COMPAT_rpi5 = "scarthgap"
LAYERDEPENDS_rpi5 = "core raspberrypi"

BBFILES += "${@' '.join('${LAYERDIR}/dynamic-layers/%s/recipes*/*/*.bbappend' % layer \
               for layer in BBFILE_COLLECTIONS.split())}"
BBFILES += "${@' '.join('${LAYERDIR}/dynamic-layers/%s/recipes*/*/*.bb' % layer \
               for layer in BBFILE_COLLECTIONS.split())}"

BBFILES_DYNAMIC += " \
    openembedded-layer:${LAYERDIR}/dynamic-layers/openembedded-layer/*/*/*.bb \
"
```
